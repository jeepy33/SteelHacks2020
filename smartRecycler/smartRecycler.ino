#include <SPI.h>
#include <Wire.h>
#include <Adafruit_GFX.h>
#include <Adafruit_SSD1306.h>
#include "qrcode.h"

#define SCREEN_WIDTH 128 // OLED display width, in pixels
#define SCREEN_HEIGHT 64 // OLED display height, in pixels

// Declaration for an SSD1306 display connected to I2C (SDA, SCL pins)
#define OLED_RESET     4 // Reset pin # (or -1 if sharing Arduino reset pin)

// Sets the display screen up
Adafruit_SSD1306 display(SCREEN_WIDTH, SCREEN_HEIGHT, &Wire, OLED_RESET);
char letters[26] = {'a', 'b', 'c', 'd', 'e', 'f','g', 'h', 'i', 'j', 'k', 'l', 'm', 'n', 'o', 'p', 'q', 'r', 's', 't', 'u', 'v', 'w', 'x', 'y', 'z'};
char scanMe[21] = {'S','c','a','n',' ','m','e',' ','f','o','r',' ','R','e','w','a','r','d','s','!'};

// bit map for "Recycle Rewards" logo
const unsigned char icon [] PROGMEM = {
  0xff, 0xff, 0xff, 0xff, 0xff, 0xff, 0xff, 0xff, 0xff, 0xff, 0xff, 0xff, 0xff, 0xff, 0xff, 0xff, 
  0xff, 0xff, 0xff, 0xff, 0xff, 0xff, 0xff, 0xff, 0xff, 0xff, 0xff, 0xff, 0xff, 0xff, 0xff, 0xff, 
  0xff, 0xff, 0xff, 0xff, 0xff, 0xff, 0xff, 0xff, 0xff, 0xff, 0xff, 0xff, 0xff, 0xff, 0xff, 0xff, 
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  0xff, 0xff, 0xff, 0xff, 0xff, 0xff, 0xff, 0xff, 0xff, 0xff, 0xff, 0xff, 0xff, 0xff, 0xff, 0xff
};


// Initialize the pins for the ultrasonic sensor
const int trigPin = 9;
const int echoPin = 10;

// Initialize the variables for checking distance
long duration;
int distance;

// setup code: code to run once
void setup() {
  
  // SSD1306_SWITCHCAPVCC = generate display voltage from 3.3V internally
  if(!display.begin(SSD1306_SWITCHCAPVCC, 0x3C)) { // Address 0x3C for 128x32
    Serial.println(F("SSD1306 allocation failed"));
    for(;;); // Don't proceed, loop forever
  }
  

  // Set the digital pins to recieve input from ultrasonic sensor
  pinMode(trigPin, OUTPUT);
  pinMode(echoPin, INPUT);
  Serial.begin(9600);
  
}

// loop code: code to run in a loop while recycler is operating
void loop() {
  // Draws the "Recycle Rewards" Logo and invert the colors
  display.clearDisplay();
  display.invertDisplay(true);
  drawIcon();
  display.display();      

  // Sending a pulse to the trigger pin to poll the ultrasonic sensor
  digitalWrite(trigPin, LOW);
  delayMicroseconds(2);
  digitalWrite(trigPin, HIGH);
  delayMicroseconds(10);

  // recieves signal from ultrasonic and translates into distance in (cm)
  duration = pulseIn(echoPin, HIGH);
  distance = duration *0.034/2;

  // testing print
  Serial.println(distance);

  // if something has dropped in the recycler
  if (distance < 10){
    // clear the display
    display.clearDisplay();

    // generates a psuedo-random number using a fluctuating empty analog input
    randomSeed(analogRead(0));

    // declares a char[] that is stored with a random string of 8 letters
    char buf[10];
    for(int i = 0; i < 8; i++){
      buf[i] = letters[random(0,26)];
    }
    
    // the point value associated with recycling is appended to the end of the string
    buf[8] = '5';
    buf[9] = '0';
    
    // declares qrcode object from library, and encodes buf[] into a byte array 
    // corresponding to the qr code it encodes
    QRCode qrcode;
    uint8_t qrcodeData[qrcode_getBufferSize(3)];
    qrcode_initText(&qrcode, qrcodeData, 3, 0, buf);

    // clear display before drawing qrcode and message
    display.clearDisplay();
    
    // for each byte / pixel that is in the encoded byte array, generate a 
    // rectangle of the proper size at the proper location
    for (uint8_t y = 0; y < qrcode.size; y++) {
      // Each horizontal module
      for (uint8_t x = 0; x < qrcode.size; x++) {
        if(qrcode_getModule(&qrcode, x, y)) {
          display.fillRect(42+(x*1.5), 18+(y*1.5), 2, 2, SSD1306_WHITE);
        }
      }
    }

    // draws "Scan me for Rewards!" message at the top of the screen
    display.setTextSize(1); 
    display.setTextColor(WHITE);
    display.setCursor(31, 0);
    display.println("Scan me for");
    display.setCursor(42, 7);
    display.println("Rewards!");
    display.display(); 

    // wait 20 seconds so that the user has time to scan the qrcode
    delay(20000);
  }
}

// function to draw image from byte array
void drawIcon(void) {
  display.drawBitmap(0,0,icon, 128, 64, 1);
  display.display();
}
